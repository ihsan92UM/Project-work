## prj.conf
```kconfig
#Button config
CONFIG_DK_LIBRARY=y

# Printing fractions and console output
CONFIG_STDOUT_CONSOLE=y
CONFIG_CBPRINTF_FP_SUPPORT=y
CONFIG_PRINTK=y

#UART
CONFIG_STDOUT_CONSOLE=y
CONFIG_SERIAL=y
CONFIG_UART_ASYNC_API=y

# I2C at i2c1
CONFIG_NRFX_TWIM1=y
CONFIG_I2C=y

# Configure logger
CONFIG_LOG=y
CONFIG_USE_SEGGER_RTT=n
CONFIG_LOG_BACKEND_RTT=n
CONFIG_LOG_BACKEND_UART=y
CONFIG_LOG_DEFAULT_LEVEL=3

# Configure Bluetooth
CONFIG_BT=y
CONFIG_BT_PERIPHERAL=y
CONFIG_BT_DEVICE_NAME="Sensor Data"
CONFIG_BT_DEVICE_APPEARANCE=0
CONFIG_BT_MAX_CONN=1
CONFIG_BT_LL_SOFTDEVICE=y
CONFIG_ASSERT=y

# Reboot
CONFIG_REBOOT=n
CONFIG_RESET_ON_FATAL_ERROR=n
```

## include/ble.h
```c
#include <zephyr/kernel.h>
#include <zephyr/logging/log.h>

#include <zephyr/bluetooth/bluetooth.h>
#include <zephyr/bluetooth/uuid.h>
#include <zephyr/bluetooth/gatt.h>
#include <zephyr/bluetooth/hci.h>



//SEND TEXT TO nRF5340
/** @brief UUID of the Message Characteristic. **/ /*no need*/
#define BT_UUID_REMOTE_MESSAGE_CHRC_VAL \
	BT_UUID_128_ENCODE(0xe9ea0001, 0xe19b, 0x482d, 0x9293, 0xc7907585fc48)


//STS40
/** @brief UUID of the STS40 temp1 Service. 101 102 103 **/
#define BT_UUID_REMOTE_SERV_VAL \
	BT_UUID_128_ENCODE(0xe9ea0101, 0xe19b, 0x482d, 0x9293, 0xc7907585fc48)

/** @brief UUID of the STS40 temp1 Characteristic. **/
#define BT_UUID_REMOTE_TEMP1_CHRC_VAL \
	BT_UUID_128_ENCODE(0xe9ea0102, 0xe19b, 0x482d, 0x9293, 0xc7907585fc48)


//LIS2DTW12
/** @brief UUID of the LIS2DTW12 Sensor Service. 201 202 203**/
#define BT_UUID_REMOTE_SERV1_VAL \
	BT_UUID_128_ENCODE(0xe9ea0201, 0xe19b, 0x482d, 0x9293, 0xc7907585fc48)

	/** @brief UUID of the Temperature Characteristic. **/
#define BT_UUID_REMOTE_TEMP2_CHRC_VAL \
	BT_UUID_128_ENCODE(0xe9ea0202, 0x44c2, 0x4f25, 0xb96d, 0x305992224e00)  

	/** @brief UUID of the ACC_X Characteristic. **/
#define BT_UUID_REMOTE_ACC_X_CHRC_VAL \
	BT_UUID_128_ENCODE(0xe9ea0203, 0xbb52, 0x4d3d, 0x8d48, 0xb2b646212bfa) 

	/** @brief UUID of the ACC_Y Characteristic. **/
#define BT_UUID_REMOTE_ACC_Y_CHRC_VAL \
	BT_UUID_128_ENCODE(0xe9ea0204, 0x1312, 0x434b, 0xa010, 0x6cc3d0aa4290)
	
	/** @brief UUID of the ACC_Z Characteristic. **/
#define BT_UUID_REMOTE_ACC_Z_CHRC_VAL \
	BT_UUID_128_ENCODE(0xe9ea0205, 0x1312, 0x434b, 0xa010, 0x6cc3d0aa4290)


// Capacitance measurements from STM32U5
/** @brief UUID of the Capacitance Service. 201 202 203**/
#define BT_UUID_REMOTE_SERV2_VAL \
	BT_UUID_128_ENCODE(0xe9ea0301, 0xe19b, 0x482d, 0x9293, 0xc7907585fc48)

/** @brief UUID of the Humidity Characteristic. **/
#define BT_UUID_REMOTE_CH0_CHRC_VAL \
	BT_UUID_128_ENCODE(0xe9ea0302, 0x1312, 0x434b, 0xa010, 0x6cc3d0aa4290)

/** @brief UUID of the Humidity Characteristic. **/
#define BT_UUID_REMOTE_CH1_CHRC_VAL \
	BT_UUID_128_ENCODE(0xe9ea0303, 0x1312, 0x434b, 0xa010, 0x6cc3d0aa4290)

/** @brief UUID of the Humidity Characteristic. **/
#define BT_UUID_REMOTE_CH2_CHRC_VAL \
	BT_UUID_128_ENCODE(0xe9ea0304, 0x1312, 0x434b, 0xa010, 0x6cc3d0aa4290)

/** @brief UUID of the Humidity Characteristic. **/
#define BT_UUID_REMOTE_CH3_CHRC_VAL \
	BT_UUID_128_ENCODE(0xe9ea0305, 0x1312, 0x434b, 0xa010, 0x6cc3d0aa4290)

/** @brief UUID of the Humidity Characteristic. **/
#define BT_UUID_REMOTE_CH4_CHRC_VAL \
	BT_UUID_128_ENCODE(0xe9ea0306, 0x1312, 0x434b, 0xa010, 0x6cc3d0aa4290)

/** @brief UUID of the Humidity Characteristic. **/
#define BT_UUID_REMOTE_CH5_CHRC_VAL \
	BT_UUID_128_ENCODE(0xe9ea0307, 0x1312, 0x434b, 0xa010, 0x6cc3d0aa4290)



//SEND TEXT TO nRF5340
#define BT_UUID_REMOTE_MESSAGE_CHRC       BT_UUID_DECLARE_128(BT_UUID_REMOTE_MESSAGE_CHRC_VAL)

//STS40
#define BT_UUID_REMOTE_SERVICE            BT_UUID_DECLARE_128(BT_UUID_REMOTE_SERV_VAL)

#define BT_UUID_REMOTE_TEMP1_CHRC         BT_UUID_DECLARE_128(BT_UUID_REMOTE_TEMP1_CHRC_VAL)


//LIS2DTW12
#define BT_UUID_REMOTE_SERVICE1            BT_UUID_DECLARE_128(BT_UUID_REMOTE_SERV1_VAL)

#define BT_UUID_REMOTE_TEMP2_CHRC          BT_UUID_DECLARE_128(BT_UUID_REMOTE_TEMP2_CHRC_VAL)
#define BT_UUID_REMOTE_ACC_X_CHRC  		   BT_UUID_DECLARE_128(BT_UUID_REMOTE_ACC_X_CHRC_VAL)
#define BT_UUID_REMOTE_ACC_Y_CHRC          BT_UUID_DECLARE_128(BT_UUID_REMOTE_ACC_Y_CHRC_VAL)
#define BT_UUID_REMOTE_ACC_Z_CHRC          BT_UUID_DECLARE_128(BT_UUID_REMOTE_ACC_Z_CHRC_VAL)

//Capacitance
#define BT_UUID_REMOTE_SERVICE2            BT_UUID_DECLARE_128(BT_UUID_REMOTE_SERV2_VAL)

#define BT_UUID_REMOTE_CH0_CHRC            BT_UUID_DECLARE_128(BT_UUID_REMOTE_CH0_CHRC_VAL)
#define BT_UUID_REMOTE_CH1_CHRC            BT_UUID_DECLARE_128(BT_UUID_REMOTE_CH1_CHRC_VAL)
#define BT_UUID_REMOTE_CH2_CHRC            BT_UUID_DECLARE_128(BT_UUID_REMOTE_CH2_CHRC_VAL)
#define BT_UUID_REMOTE_CH3_CHRC            BT_UUID_DECLARE_128(BT_UUID_REMOTE_CH3_CHRC_VAL)
#define BT_UUID_REMOTE_CH4_CHRC            BT_UUID_DECLARE_128(BT_UUID_REMOTE_CH4_CHRC_VAL)
#define BT_UUID_REMOTE_CH5_CHRC            BT_UUID_DECLARE_128(BT_UUID_REMOTE_CH5_CHRC_VAL)




enum bt_button_notifications_enabled {
	BT_BUTTON_NOTIFICATIONS_ENABLED,
	BT_BUTTON_NOTIFICATIONS_DISABLED,
};

struct bt_remote_service_cb {
	void (*notif_changed)(enum bt_button_notifications_enabled status);
    void (*data_received)(struct bt_conn *conn, const uint8_t *const data, uint16_t len);
};


//edited

int bluetooth_init(struct bt_conn_cb *bt_cb, struct bt_remote_service_cb *remote_cb);

int send_temp1_notification(struct bt_conn *conn, float value);

int send_temp2_notification(struct bt_conn *conn, float value);
int send_acc_x_notification(struct bt_conn *conn, float value);
int send_acc_y_notification(struct bt_conn *conn, float value);
int send_acc_z_notification(struct bt_conn *conn, float value);

void set_temp1_status(float tmp1_value);

void set_temp2_status(float tmp2_value);
void set_acc_x_status(float accx_value);
void set_acc_y_status(float accy_value);
void set_acc_z_status(float accz_value);


int send_ch0_notification(struct bt_conn *conn, float value);
int send_ch1_notification(struct bt_conn *conn, float value);
int send_ch2_notification(struct bt_conn *conn, float value);
int send_ch3_notification(struct bt_conn *conn, float value);
int send_ch4_notification(struct bt_conn *conn, float value);
int send_ch5_notification(struct bt_conn *conn, float value);

void set_ch0_status(float ch0_val);
void set_ch1_status(float ch1_val);
void set_ch2_status(float ch2_val);
void set_ch3_status(float ch3_val);
void set_ch4_status(float ch4_val);
void set_ch5_status(float ch5_val);

//edited
```

## include/uart_rx.h
```c
#ifndef UART_RX_H
#define UART_RX_H

#include <zephyr/kernel.h>
#include <zephyr/drivers/uart.h>

#define RX_BUFFER_SIZE 15
extern uint16_t uart_rx_values[6];

void uart_init(void);

#endif 
```

## src/lis2dtw12.c
```c
#include "lis2dtw12.h"

static const struct i2c_dt_spec dev_i2c_lis2dtw12 = I2C_DT_SPEC_GET(I2C1_NODE_LIS2DTW12);

void lis2dtw12_init(void) {
    if (!device_is_ready(dev_i2c_lis2dtw12.bus)) {
        printk("I2C bus %s is not ready!\n", dev_i2c_lis2dtw12.bus->name);
    }
    // Configure sensor
    uint8_t ctrl1[] = {0x20, 0x75};  // Set ODR and mode
    if (i2c_write_dt(&dev_i2c_lis2dtw12, ctrl1, sizeof(ctrl1)) != 0) {
        //printk("Failed to configure CTRL1 register\n");
        return -1;
    }

    uint8_t ctrl6[] = {0x25, 0x04};  // Set filter, FS, and low noise mode
    if (i2c_write_dt(&dev_i2c_lis2dtw12, ctrl6, sizeof(ctrl6)) != 0) {
        //printk("Failed to configure CTRL6 register\n");
        return -1;
    }

    //printk("LIS2DTW12 initialized successfully!\n");
    return 0;
}

float lis2dtw12_read_temperature(void) {
    uint8_t registers[] = {0x0D, 0x0E};
    uint8_t data[2] = {0};
    for (int i = 0; i < 2; i++) {
        int ret = i2c_write_read_dt(&dev_i2c_lis2dtw12, &registers[i], 1, &data[i], 1);
        if (ret != 0) {
            printk("Failed to read temperature register 0x%X\n", registers[i]);
            return -999.0;
        }
    }
    int16_t temp_raw = (data[1] << 8) | data[0];
    return (float)temp_raw / 256.0 + 25.0;
}

void lis2dtw12_read_data(float *x, float *y, float *z) {
    uint8_t registers[] = {0x28, 0x29, 0x2A, 0x2B, 0x2C, 0x2D};
    uint8_t data[6] = {0};
    for (int i = 0; i < 6; i++) {
        int ret = i2c_write_read_dt(&dev_i2c_lis2dtw12, &registers[i], 1, &data[i], 1);
        if (ret != 0) {
            printk("Failed to read register 0x%X\n", registers[i]);
            return;
        }
    }
    
    int16_t x_raw = (data[1] << 8) | data[0];
    int16_t y_raw = (data[3] << 8) | data[2];
    int16_t z_raw = (data[5] << 8) | data[4];
    
    *x = x_raw * 0.061;
    *y = y_raw * 0.061;
    *z = z_raw * 0.061;
}
```

## src/uart_rx.c
```c
// uart_rx.c
#include "uart_rx.h"
#include <zephyr/sys/printk.h>

static uint8_t rxBuffer[RX_BUFFER_SIZE];
static uint8_t rxIndex = 0;
uint16_t uart_rx_values[6];

static void uart_cb(const struct device *dev, struct uart_event *evt, void *user_data)
{
	switch (evt->type) {
	case UART_TX_DONE:
		break;
	case UART_TX_ABORTED:
		break;
	case UART_RX_RDY:
		for (int i = 0; i < evt->data.rx.len; i++) {
			if (rxIndex >= RX_BUFFER_SIZE) {
				rxIndex = 0;
			}
			rxBuffer[rxIndex++] = evt->data.rx.buf[evt->data.rx.offset + i];
			if (rxIndex == RX_BUFFER_SIZE) {
				if (rxBuffer[0] == 0xAA && rxBuffer[RX_BUFFER_SIZE - 2] == 0x55) {
					for (int j = 0; j < 6; j++) {
						uart_rx_values[j] = (rxBuffer[1 + 2 * j] << 8) | rxBuffer[2 + 2 * j];
					}
					printk("Received: %d, %d, %d, %d, %d, %d\n",
						uart_rx_values[0], uart_rx_values[1], uart_rx_values[2], uart_rx_values[3], uart_rx_values[4], uart_rx_values[5]);
				} else {
					printk("Invalid packet format!\n");
				}
				rxIndex = 0;
			}
		}
		break;
	case UART_RX_BUF_REQUEST:
		break;
	case UART_RX_BUF_RELEASED:
		break;
	case UART_RX_DISABLED:
		uart_rx_enable(dev, rxBuffer, sizeof(rxBuffer), 100);
		break;
	case UART_RX_STOPPED:
		break;
	default:
		break;
	}
}

void uart_init(void)
{
	const struct device *uart = DEVICE_DT_GET(DT_NODELABEL(uart0));
	if (!device_is_ready(uart)) {
		printk("UART device %s is not ready\n", uart->name);
		return;
	}

	const struct uart_config uart_cfg = {
		.baudrate = 115200,
		.parity = UART_CFG_PARITY_NONE,
		.stop_bits = UART_CFG_STOP_BITS_1,
		.data_bits = UART_CFG_DATA_BITS_8,
		.flow_ctrl = UART_CFG_FLOW_CTRL_NONE
	};

	int err = uart_configure(uart, &uart_cfg);
	if (err == -ENOSYS) {
		return;
	}

	err = uart_callback_set(uart, uart_cb, NULL);
	if (err) {
		return;
	}

	uart_rx_enable(uart, rxBuffer, sizeof(rxBuffer), 100);
}
```
